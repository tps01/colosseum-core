## infra/yocto/meta-colosseum-test/conf/layer.conf
```bitbake
BBPATH .= ":${LAYERDIR}"

BBFILES += "${LAYERDIR}/recipes-*/*/*.bb \
            ${LAYERDIR}/recipes-*/*/*.bbappend"

BBFILE_COLLECTIONS += "colosseum-test"
BBFILE_PATTERN_colosseum-test := "^${LAYERDIR}/"
BBFILE_PRIORITY_colosseum-test = "6"

LAYERDEPENDS_colosseum-test = "core"
LAYERSERIES_COMPAT_colosseum-test = "kirkstone"
```
